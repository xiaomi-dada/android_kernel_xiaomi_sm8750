## drivers/firmware/cirrus/Kconfig
```kconfig
# SPDX-License-Identifier: GPL-2.0-only

config FW_CS_DSP
	tristate "Cirrus Logic DSP firmware support"
	default n
	help
	  Firmware loading and control for the Cirrus Logic DSP cores found
	  in their audio codecs.  In-tree codec drivers select this; say M
	  here only to build it for a codec driver that lives outside the
	  tree, which is how the CS35L43 amplifiers on some boards are
	  driven.

	  If unsure, say N.
```

## drivers/misc/hwid/Kconfig
```kconfig
# SPDX-License-Identifier: GPL-2.0-only

config MI_HARDWARE_ID
	tristate "Xiaomi board identification"
	help
	  Answers which board this is and which region it was sold in, from
	  what the bootloader puts on the kernel command line.  The Xiaomi
	  drivers use it to adjust for hardware revision.

	  Say M here to build it as a module, hwid.ko.  If unsure, say N.
```

## drivers/power/supply/mca/Kconfig
```kconfig
# SPDX-License-Identifier: GPL-2.0-only

menu "Xiaomi MCA charging support"

config XM_POWER_SUPPLY
	tristate "Xiaomi Mi Charging Architecture"
	help
	  Xiaomi's charging stack.  It replaces the platform's own charging
	  driver with a layered arrangement: hardware drivers underneath, a
	  class layer that hides which part is fitted, and strategies above
	  that decide what the charge should be doing.

	  The parts are separate modules and load in dependency order; this
	  option builds all of them, because none is useful on its own.

	  Say M here to build them as modules.  If unsure, say N.

endmenu
```
